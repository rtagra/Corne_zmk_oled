/ {
    // THIS PART IS THE KEY: it connects the hardware to the firmware
    chosen {
        zmk,battery = &vbatt;
    };

    vbatt: vbatt {
        compatible = "zmk,battery-voltage-divider";
        io-channels = <&adc 2>; 
        output-ohms = <1000000>;
        full-ohms = <2000000>;
    };
};

&adc {
    status = "okay";
};
